## conf/layer.conf
```bitbake
# We have a conf and classes directory, add to BBPATH
BBPATH .= ":${LAYERDIR}"

# We have recipes-* directories, add to BBFILES
BBFILES += "${LAYERDIR}/recipes-*/*/*.bb \
            ${LAYERDIR}/recipes-*/*/*.bbappend"

BBFILE_COLLECTIONS += "meta-custom"
BBFILE_PATTERN_meta-custom = "^${LAYERDIR}/"
BBFILE_PRIORITY_meta-custom = "6"

LAYERDEPENDS_meta-custom = "core"
LAYERSERIES_COMPAT_meta-custom = "kirkstone"

BB_NUMBER_THREADS = "4"
BB_NUMBER_PARSE_THREADS = "4"
PARALLEL_MAKE = "-j 4"

IMAGE_FSTYPES += "wic wic.vdi"
WKS_FILE = "${LAYERDIR}/wic/biosplusefi_plugin.wks"

IMAGE_INSTALL:append = " opkg vim git ethtool rsync lua parted efibootmgr"
IMAGE_INSTALL:append = " e2fsprogs-e2fsck e2fsprogs-mke2fs e2fsprogs-tune2fs e2fsprogs-badblocks e2fsprogs-resize2fs"
IMAGE_INSTALL:append = " gptfdisk util-linux minicom screen qemu i2c-tools pciutils usbutils"
IMAGE_INSTALL:append = " sato-screenshot python3-pip python3-venv curl iproute2 iproute2-ss iptables iw"
IMAGE_INSTALL:append = " at procps sysstat logrotate dmidecode socat"

MACHINE_EXTRA_RRECOMMENDS:append = " kernel-module-pktgen"
```

## wic/biosplusefi_plugin.wks
```
# short-description: This file is copied from meta-selftest/wic/test_biosplusefi_plugin.wks

part /boot --source bootimg-biosplusefi --sourceparams="loader=grub-efi" --active --align 1024 --use-uuid
part / --source rootfs --fstype=ext4 --align 1024 --use-uuid

bootloader  --timeout=0 --append="console=ttyS0,115200n8"
```
